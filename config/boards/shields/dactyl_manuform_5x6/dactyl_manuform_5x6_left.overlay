#include "dactyl_manuform_5x6.dtsi" // Notice that the main dtsi files are included in the overlay.

&kscan0 {
    col-gpios
        = <&pro_micro 009 GPIO_ACTIVE_HIGH>
        , <&pro_micro 010 GPIO_ACTIVE_HIGH>
        , <&pro_micro 111 GPIO_ACTIVE_HIGH>
        , <&pro_micro 113 GPIO_ACTIVE_HIGH>
        , <&pro_micro 115 GPIO_ACTIVE_HIGH>
        , <&pro_micro 002 GPIO_ACTIVE_HIGH>
        ;
};