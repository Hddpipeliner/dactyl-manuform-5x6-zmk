#include "dactyl_manuform_5x6.dtsi"

&default_transform { // The matrix transform for this board is 6 columns over because the left half is 6 columns wide according to the matrix.
    col-offset = <6>;
};

&kscan0 {
    col-gpios
        = <&pro_micro 009 GPIO_ACTIVE_HIGH>
        , <&pro_micro 010 GPIO_ACTIVE_HIGH>
        , <&pro_micro 111 GPIO_ACTIVE_HIGH>
        , <&pro_micro 113 GPIO_ACTIVE_HIGH>
        , <&pro_micro 115 GPIO_ACTIVE_HIGH>
        , <&pro_micro 002 GPIO_ACTIVE_HIGH>
        ;
};
